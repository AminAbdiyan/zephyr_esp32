## prj.conf
```kconfig
# Added automatically by Workbench for Zephyr
#--- DEBUG PRESET - BEGIN ---#
# Set to -Og
CONFIG_DEBUG_OPTIMIZATIONS=y
# Thread awareness support
CONFIG_DEBUG_THREAD_INFO=y
# Generate stack usage per-function
CONFIG_STACK_USAGE=y
# Other options in case not set by default
CONFIG_BUILD_OUTPUT_HEX=y
CONFIG_BUILD_OUTPUT_META=y
CONFIG_OUTPUT_SYMBOLS=y
CONFIG_OUTPUT_STAT=y
CONFIG_OUTPUT_DISASSEMBLY=y
CONFIG_OUTPUT_PRINT_MEMORY_USAGE=y
#--- DEBUG PRESET - END ---#
CONFIG_ESP32_USE_UNSUPPORTED_REVISION=y
```

## boards/esp32_devkitc_procpu.overlay
```dts
/*
 * Copyright (c) 2026
 * SPDX-License-Identifier: Apache-2.0
 */

&i2c0 {
	status = "okay";
	clock-frequency = <I2C_BITRATE_STANDARD>;
	sda-gpios = <&gpio0 21 GPIO_OPEN_DRAIN>;
	scl-gpios = <&gpio0 22 GPIO_OPEN_DRAIN>;
};
```

## src/main.cpp
```c
#include <zephyr/kernel.h>
#include <zephyr/logging/log.h>

#include "app/app_status.hpp"
#include "app/display/display_task.hpp"
#include "platform/zephyr_auxdisplay_adapter.hpp"

LOG_MODULE_REGISTER(app_main, LOG_LEVEL_INF);

namespace {
app::platform::ZephyrAuxdisplayAdapter g_display_adapter{};
app::display::DisplayTask g_display_task{g_display_adapter};
}  // namespace

int main()
{
    LOG_INF("Starting ESP32 HD44780 LCD application...");

    const app::Status status = g_display_task.Start();
    if (!app::IsOk(status)) {
        LOG_ERR("Failed to start display task: %d", static_cast<int>(status));
        return static_cast<int>(status);
    }

    LOG_INF("Application initialization complete, display task running");
    return 0;
}
```
