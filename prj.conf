## CMakeLists.txt
```
# SPDX-License-Identifier: Apache-2.0

cmake_minimum_required(VERSION 3.20.0)

set(DTC_OVERLAY_FILE "${CMAKE_CURRENT_SOURCE_DIR}/overlay/esp32_devkitc_procpu.overlay" CACHE STRING "" FORCE)

# Ensure ZEPHYR_BASE is exported to subprocess environments (needed for west commands)
if(NOT DEFINED ENV{ZEPHYR_BASE})
    set(ENV{ZEPHYR_BASE} "C:/Users/amin_/Desktop/Projekte/zephyr/zephyr_west_sdk/esp32/deps/zephyr")
endif()

find_package(Zephyr REQUIRED HINTS $ENV{ZEPHYR_BASE})

project(zephyr_esp32_lcd)

target_sources(app PRIVATE
    src/main.cpp
    src/display/display_task.cpp
    src/http/http_server_task.cpp
    src/platform/zephyr_auxdisplay_adapter.cpp
    src/platform/zephyr_mpu6050_adapter.cpp
    src/sensor/sensor_task.cpp
    src/storage/credentials_storage.cpp
    src/terminal/terminal_input.cpp
    src/wifi/wifi_manager.cpp
    src/wifi/wifi_orchestrator.cpp
)

target_include_directories(app PRIVATE
    src
)

target_compile_options(app PRIVATE
    $<$<COMPILE_LANGUAGE:CXX>:
        -fno-exceptions
        -fno-rtti
        -fno-threadsafe-statics
        -Wall
        -Wextra
    >
)
```

## prj.conf
```kconfig
# Added automatically by Workbench for Zephyr
#--- DEBUG PRESET - BEGIN ---#
# Set to -Og
CONFIG_DEBUG_OPTIMIZATIONS=y
# Thread awareness support
CONFIG_DEBUG_THREAD_INFO=y
# Generate stack usage per-function
CONFIG_STACK_USAGE=y
# Other options in case not set by default
CONFIG_BUILD_OUTPUT_HEX=y
CONFIG_BUILD_OUTPUT_META=y
CONFIG_OUTPUT_SYMBOLS=y
CONFIG_OUTPUT_STAT=y
CONFIG_OUTPUT_DISASSEMBLY=y
CONFIG_OUTPUT_PRINT_MEMORY_USAGE=y
#--- DEBUG PRESET - END ---#
CONFIG_ESP32_USE_UNSUPPORTED_REVISION=y

# Subsystems and Drivers
CONFIG_I2C=y
CONFIG_GPIO=y
CONFIG_LOG=y

# Sensor Subsystem & MPU6050 Driver
CONFIG_SENSOR=y
CONFIG_MPU6050_TRIGGER_NONE=y
CONFIG_CBPRINTF_FP_SUPPORT=y

# Embedded C++17 Support
CONFIG_CPP=y
CONFIG_STD_CPP17=y

# Memory and Stacks
# 64 KB heap required for Espressif Wi-Fi binary blobs and network packet buffers
CONFIG_HEAP_MEM_POOL_SIZE=65536
CONFIG_MAIN_STACK_SIZE=4096

# Flash and Non-Volatile Storage (NVS)
# Used to store Wi-Fi SSID and Password persistently on internal flash
CONFIG_FLASH=y
CONFIG_FLASH_PAGE_LAYOUT=y
CONFIG_FLASH_MAP=y
CONFIG_NVS=y
CONFIG_MPU_ALLOW_FLASH_WRITE=y

# Serial Console Input
# Enables console_getchar() for interactive SSID/password entry via serial terminal
CONFIG_CONSOLE_SUBSYS=y
CONFIG_CONSOLE_GETCHAR=y
CONFIG_CONSOLE_GETCHAR_BUFSIZE=256
CONFIG_CONSOLE_PUTCHAR_BUFSIZE=256

# Networking and Wi-Fi Subsystem
CONFIG_NETWORKING=y
CONFIG_NET_L2_WIFI_MGMT=y
CONFIG_NET_L2_ETHERNET=y
CONFIG_WIFI=y
CONFIG_WIFI_ESP32=y

# IPv4 and DHCPv4 Client
CONFIG_NET_IPV4=y
CONFIG_NET_DHCPV4=y
CONFIG_NET_UDP=y
CONFIG_NET_TCP=y
CONFIG_NET_STATISTICS=n

# BSD Socket API for Embedded HTTP Web Server
CONFIG_NET_SOCKETS=y
CONFIG_NET_CONNECTION_MANAGER=y

# Network Buffer Allocation
CONFIG_NET_PKT_RX_COUNT=16
CONFIG_NET_PKT_TX_COUNT=32
CONFIG_NET_BUF_RX_COUNT=64
CONFIG_NET_BUF_TX_COUNT=128
CONFIG_NET_BUF_DATA_SIZE=256
CONFIG_NET_MAX_CONTEXTS=10
```

## src/main.cpp
```c
/**
 * @file main.cpp
 * @brief Application composition root and startup entry point.
 *
 * Architecture Role:
 * - Adheres strictly to the "Composition Root" pattern.
 * - Instantiates concrete platform drivers (ZephyrAuxdisplayAdapter, ZephyrMpu6050Adapter),
 *   persistent storage (CredentialsStorage), Wi-Fi manager (WifiManager), serial terminal reader,
 *   Wi-Fi orchestrator (WifiOrchestrator), HTTP server (HttpServerTask), the shared thread-safe
 *   SensorDataHub, and application worker tasks (SensorTask, DisplayTask).
 * - Statically allocates all objects in BSS to prevent dynamic memory fragmentation (MISRA C++).
 * - Controls the multi-stage startup sequencing:
 *   1. Hardware & LCD initialization.
 *   2. Persistent NVS flash initialization.
 *   3. Wi-Fi setup via WifiOrchestrator (credential loading, terminal prompt, retries, LCD updates).
 *   4. Embedded HTTP web server launch on port 80 (instantly browsable).
 *   5. 5-second pause so the user can view the assigned IP on the LCD.
 *   6. Periodic SensorTask (1 Hz polling) and DisplayTask (IMU data rendering on LCD) launch.
 */

#include <zephyr/kernel.h>
#include <zephyr/logging/log.h>

#include "common/app_status.hpp"
#include "display/display_task.hpp"
#include "http/http_server_task.hpp"
#include "platform/zephyr_auxdisplay_adapter.hpp"
#include "platform/zephyr_mpu6050_adapter.hpp"
#include "sensor/sensor_data.hpp"
#include "sensor/sensor_task.hpp"
#include "storage/credentials_storage.hpp"
#include "terminal/terminal_input.hpp"
#include "wifi/wifi_manager.hpp"
#include "wifi/wifi_orchestrator.hpp"

// Register the root application logging module
LOG_MODULE_REGISTER(app_main, LOG_LEVEL_INF);

namespace {
/**
 * Statically allocated hardware adapters and tasks.
 * Persist for the entire lifetime of the embedded device in BSS (zero dynamic heap allocation).
 */

/// I2C adapter driving the HD44780 1602 LCD via PCF8574 backpack
app::platform::ZephyrAuxdisplayAdapter g_display_adapter{};

/// I2C adapter communicating with the MPU6050 6-DOF IMU sensor
app::platform::ZephyrMpu6050Adapter g_mpu6050_adapter{};

/// Thread-safe data hub transferring IMU readings from SensorTask to DisplayTask and HttpServerTask
app::sensor::SensorDataHub g_sensor_data_hub{};

/// Periodic task sampling MPU6050 at 1 Hz and logging readings to console
app::sensor::SensorTask g_sensor_task{g_mpu6050_adapter, g_sensor_data_hub};

/// Periodic task updating the LCD with the latest IMU readings
app::display::DisplayTask g_display_task{g_display_adapter, g_sensor_data_hub};

/// Persistent flash storage for Wi-Fi credentials using NVS
app::storage::CredentialsStorage g_credentials_storage{};

/// Serial console input reader for interactive credentials entry
app::terminal::TerminalInput g_terminal_input{};

/// Wi-Fi station connection manager
app::wifi::WifiManager g_wifi_manager{};

/// High-level Wi-Fi setup orchestrator (coordinates storage, terminal input, retries, and display)
app::wifi::WifiOrchestrator g_wifi_orchestrator{
    g_credentials_storage,
    g_wifi_manager,
    g_terminal_input,
    g_display_task};

/// Embedded HTTP server listening on port 80 for web dashboard
app::http::HttpServerTask g_http_server_task{g_sensor_data_hub};

/// Buffer holding the acquired IPv4 address string
char g_ip_str[app::wifi::WifiManager::kMaxIpStringLength] = {};

}  // namespace

/**
 * @brief Zephyr RTOS application entry point.
 *
 * Implements clean, top-level composition and lifecycle sequencing.
 *
 * @return 0 on success, or non-zero status code on failure.
 */
int main()
{
    LOG_INF("==================================================");
    LOG_INF("Starting ESP32 MPU6050 IMU & HD44780 LCD Application");
    LOG_INF("==================================================");

    // 1. Initialize LCD hardware display controller first so boot progress can be displayed
    const app::Status lcd_init_status = g_display_task.InitHardware();
    if (!app::IsOk(lcd_init_status)) {
        LOG_ERR("Failed to initialize LCD hardware: %d", static_cast<int>(lcd_init_status));
        return static_cast<int>(lcd_init_status);
    }

    (void)g_display_task.ShowMessage("System Starting", "Initializing...");

    // 2. Initialize persistent flash storage (NVS)
    const app::Status storage_status = g_credentials_storage.Initialize();
    if (!app::IsOk(storage_status)) {
        LOG_ERR("Failed to initialize NVS flash storage: %d", static_cast<int>(storage_status));
        (void)g_display_task.ShowMessage("Storage Error", "NVS Mount Failed");
        return static_cast<int>(storage_status);
    }

    // 3. Coordinate Wi-Fi provisioning, persistent loading, connection attempts, and LCD feedback
    const app::Status wifi_status = g_wifi_orchestrator.SetupNetwork(g_ip_str, sizeof(g_ip_str));
    if (!app::IsOk(wifi_status)) {
        LOG_ERR("Failed to configure Wi-Fi network: %d", static_cast<int>(wifi_status));
        return static_cast<int>(wifi_status);
    }

    // 4. Start HTTP Server Task immediately so web dashboard is accessible right after connection
    const app::Status http_status = g_http_server_task.Start();
    if (!app::IsOk(http_status)) {
        LOG_ERR("Failed to start HTTP server task: %d", static_cast<int>(http_status));
    }

    // 5. Wait 5 seconds so the user can comfortably view the assigned IP on the LCD
    LOG_INF("Waiting 5 seconds before starting sensor acquisition and display updates...");
    k_sleep(K_SECONDS(5));

    // 6. Start Sensor Task (MPU6050 1 Hz polling)
    const app::Status sensor_status = g_sensor_task.Start();
    if (!app::IsOk(sensor_status)) {
        LOG_ERR("Failed to start sensor task: %d", static_cast<int>(sensor_status));
        return static_cast<int>(sensor_status);
    }

    // 7. Start Display Task (IMU display update loop)
    const app::Status display_status = g_display_task.Start();
    if (!app::IsOk(display_status)) {
        LOG_ERR("Failed to start display task: %d", static_cast<int>(display_status));
        return static_cast<int>(display_status);
    }

    LOG_INF("System initialization complete: All tasks (Sensor, Display, HTTP) active.");

    return 0;
}
```
